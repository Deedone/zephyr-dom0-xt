## west.yml
```yaml
# SPDX-License-Identifier: Apache-2.0
# West YAML manifest for Zephyr as Xen Dom0

manifest:
  self:
    path: zephyr-dom0-xt

  remotes:
    - name: xentroops
      url-base: https://github.com/xen-troops/
    - name: zephyrproject-rtos
      url-base: https://github.com/zephyrproject-rtos
    - name: ddone
      url-base: https://github.com/Deedone

  projects:
    - name: zephyr
      remote: ddone
      revision: zephyr-v3.6.0-xt-v7
      west-commands: scripts/west-commands.yml

    - name: zephyr-xenlib
      remote: ddone
      revision: wip_zephyr_3.6-v2

    - name: zephyr-optee-client
      remote: ddone
      revision: wip_zephyr_3.6-v1
```
